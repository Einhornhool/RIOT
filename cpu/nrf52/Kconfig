## cpu/nrf52/Kconfig
```kconfig
# Copyright (c) 2020 HAW Hamburg
#
# This file is subject to the terms and conditions of the GNU Lesser
# General Public License v2.1. See the file LICENSE in the top level
# directory for more details.

config CPU_NRF52
    bool
    default y
    select HAS_periph_adc
    select HAS_ble_nimble_netif
    select HAS_HW_AES
    select HAS_HW_HASH_SHA1
    select HAS_HW_HASH_SHA256
    select CPU_NRF5X_COMMON

config COMPONENT_lib_cryptocell
    bool
    default y if COMPONENT_periph_hash_sha1 || COMPONENT_periph_hash_sha256 || COMPONENT_periph_crypto_aes

source "$(RIOTCPU)/nrf5x_common/Kconfig"
```

## pkg/Kconfig
```kconfig
# Copyright (c) 2019 HAW Hamburg
#
# This file is subject to the terms and conditions of the GNU Lesser
# General Public License v2.1. See the file LICENSE in the top level
# directory for more details.
#
menu "Packages"

rsource "cryptoauthlib/Kconfig"
rsource "driver_bme680/Kconfig"
rsource "tinydtls/Kconfig"
rsource "wakaama/Kconfig"
rsource "psa_arch_tests/Kconfig"

endmenu # Packages
```

## pkg/cryptoauthlib/psa_se_driver/Kconfig
```kconfig
# Copyright (c) 2021 HAW Hamburg
#
# This file is subject to the terms and conditions of the GNU Lesser
# General Public License v2.1. See the file LICENSE in the top level
# directory for more details.
#

config MODULE_PSA_SE_DRIVER
    bool
    depends on PACKAGE_CRYPTOAUTHLIB
    default y if MODULE_PSA_CRYPTO

config PSA_SECURE_ELEMENT_ECC
    bool "Use Cryptoauthlib Elliptic Curve"
    select PSA_KEY_SIZE_256
    select PSA_SECURE_ELEMENT_ASYMMETRIC
```

## pkg/mbedtls/psa_mbedtls/Kconfig
```kconfig
# Copyright (c) 2022 HAW Hamburg
#
# This file is subject to the terms and conditions of the GNU Lesser
# General Public License v2.1. See the file LICENSE in the top level
# directory for more details.
#

config MODULE_PSA_MBEDTLS_ECC_P256
    bool
    depends on MODULE_PSA_CRYPTO
    select MODULE_PSA_MBEDTLS

config MODULE_PSA_MBEDTLS_HASHES_SHA256
    bool
    depends on MODULE_PSA_CRYPTO
    select MODULE_PSA_MBEDTLS

config MODULE_PSA_MBEDTLS_ERROR_CONVERSION
    bool

config MODULE_PSA_MBEDTLS
    bool
    select MODULE_PSA_MBEDTLS_ERROR_CONVERSION
```

## sys/psa_crypto/Kconfig
```kconfig
# Copyright (c) 2021 HAW Hamburg
#
# This file is subject to the terms and conditions of the GNU Lesser
# General Public License v2.1. See the file LICENSE in the top level
# directory for more details.
#
menu "PSA Crypto"
    depends on TEST_KCONFIG

menuconfig MODULE_PSA_CRYPTO
    bool "PSA Crypto API Hash Implementation"

if MODULE_PSA_CRYPTO

menuconfig HASHES_SHA1
    bool "SHA-1"

if HASHES_SHA1

choice HASHES_SHA1_IMPLEMENTATION
    bool "SHA-1 implementation"
    default PERIPH_HASHES_SHA1

config PERIPH_HASHES_SHA1
    bool "Hardware accelerated"
    depends on HAS_HW_HASH_SHA1
    select PERIPH_HASHES

config SW_HASH_SHA1
    bool "Software implemented"
    select MODULE_HASHES_SHA1

endchoice

endif # HASHES_SHA1

menuconfig HASHES_SHA256
    bool "SHA-256"

if HASHES_SHA256

choice HASHES_256_IMPLEMENTATION
    bool "SHA-256 implementation"
    default PERIPH_HASHES_SHA256

config PERIPH_HASHES_SHA256
    bool "Hardware accelerated"
    depends on HAS_HW_HASH_SHA256
    select PERIPH_HASHES

config CRYPTOAUTHLIB_HASH_SHA256
    bool "Microchip Cryptoauth Package"
    select PACKAGE_CRYPTOAUTHLIB
    select MODULE_CRYPTOAUTHLIB_HASHES
    select SE_HASHES

config SW_HASH_SHA256
    bool "Software implemented"
    select MODULE_HASHES_SHA256

endchoice
endif # HASHES_SHA256
endif # MODULE_PSA_CRYPTO

config SE_HASHES
    bool
    help
        Indicates use of a secure element.

endmenu # PSA_Crypto
```

## sys/psa_crypto/psa_se_mgmt/Kconfig
```kconfig
# Copyright (c) 2022 HAW Hamburg
#
# This file is subject to the terms and conditions of the GNU Lesser
# General Public License v2.1. See the file LICENSE in the top level
# directory for more details.
#


menuconfig PSA_SECURE_ELEMENT
    bool "PSA Secure Element Configuration"
    select MODULE_PSA_KEY_SLOT_MGMT
    select MODULE_PSA_SE_MGMT

if PSA_SECURE_ELEMENT

config MODULE_PSA_SE_MGMT
    bool

config PSA_SE_ATECCX08A
    bool "Microchip Cryptoauthlib Driver"
    select PACKAGE_CRYPTOAUTHLIB

config PSA_MULTIPLE_SECURE_ELEMENTS
    bool "Use multiple secure elements"

config PSA_MAX_SE_COUNT
    int "Sets maximum number of usable SEs"
    default 2 if PSA_MULTIPLE_SECURE_ELEMENTS
    default 1

config PSA_SECURE_ELEMENT_ASYMMETRIC
    bool
    help
        Indicate that an asymmetric operation is used

endif # PSA_SECURE_ELEMENT
```
